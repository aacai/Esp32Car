## main/Kconfig.projbuild
```kconfig
menu "Car Configuration"

    config ENABLE_BLE
        bool "Enable Bluetooth LE control (ESP32-C3 仅支持 BLE)"
        default y

    config EXAMPLE_WIFI_SSID
        string "WiFi SSID"
        default "ImmortalWrt-2.4G"
    config EXAMPLE_WIFI_PASSWORD
        string "WiFi Password"
        default "3355260463"

    menu "Motor (L298N) GPIO"
        config MOTOR_IN1_GPIO
            int "IN1 (left dir +)"
            default 1
        config MOTOR_IN2_GPIO
            int "IN2 (left dir -)"
            default 3
        config MOTOR_IN3_GPIO
            int "IN3 (right dir +)"
            default 4
        config MOTOR_IN4_GPIO
            int "IN4 (right dir -)"
            default 5
        config MOTOR_ENA_GPIO
            int "ENA (left PWM speed)"
            default 2
            help "禁止设为 18/19，那是 ESP32-C3 的 USB D-/D+ 引脚"
        config MOTOR_ENB_GPIO
            int "ENB (right PWM speed)"
            default 10
            help "禁止设为 18/19，那是 ESP32-C3 的 USB D-/D+ 引脚"
    endmenu

endmenu
```

## sdkconfig.defaults
```kconfig
# 目标芯片：ESP32-C3（RISC-V）
CONFIG_IDF_TARGET="esp32c3"

# 功能开关
CONFIG_ENABLE_BLE=y

# WiFi 凭据（可改这里或用 menuconfig）
CONFIG_EXAMPLE_WIFI_SSID="your_ssid"
CONFIG_EXAMPLE_WIFI_PASSWORD="your_password"

# 电机 GPIO（L298N，见 README 接线一节；⚠️ 18/19 是 USB D+/D+，绝对不能用）
CONFIG_MOTOR_IN1_GPIO=1
CONFIG_MOTOR_IN2_GPIO=3
CONFIG_MOTOR_IN3_GPIO=4
CONFIG_MOTOR_IN4_GPIO=5
CONFIG_MOTOR_ENA_GPIO=2
CONFIG_MOTOR_ENB_GPIO=10

# 串口波特率
CONFIG_ESP_CONSOLE_UART_BAUDRATE_115200=y

# 看门狗超时放宽，便于调试
CONFIG_ESP_TASK_WDT_TIMEOUT_S=30

# OTA 防变砖：新固件若首次启动崩溃/起不来，bootloader 自动回滚到上一版本
# （配合 main.c 里 esp_ota_mark_app_valid_cancel_rollback() 标记健康）
CONFIG_BOOTLOADER_APP_ROLLBACK_ENABLE=y

# Bluetooth（ESP32-C3 仅 BLE）
CONFIG_BT_ENABLED=y
CONFIG_BT_NIMBLE_ENABLED=y
CONFIG_BTDM_CTRL_MODE_BLE_ONLY=y

# 分区表：放大 factory 分区以容纳 BLE + HTTP + WiFi 固件
CONFIG_PARTITION_TABLE_CUSTOM=y
CONFIG_PARTITION_TABLE_FILENAME="partitions.csv"
CONFIG_ESPTOOLPY_FLASHSIZE_4MB=y
```
